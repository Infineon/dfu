#! armclang -E --target=arm-arm-none-eabi -x c -mcpu=cortex-m4
; The first line specifies a preprocessor command that the linker invokes
; to pass a scatter file through a C preprocessor.

;***************************************************************************//**
;* \file dfu_cm4_app1.sct
;* \version 4.20
;*
;* The linker file for the ARM compiler.
;* Used for the DFU SDK application 1 firmware project. 
;* Contains only CM4 sections (no section for the CM0p image that 
;* starts CM4 application 0). Application 1 is uploaded through 
;* Bootloader Host Tool using the generated cyadc2 file.
;*
;*
;* \note
;* This linker file is generic and handles common use cases. Your project may  
;* not use each section defined in the linker file and then you may see  
;* warnings during the build process: L6314W (no section matches the pattern) 
;* and/or L6329W (the pattern only matches removed unused sections).  
;* You can suppress a warning by passing the "--diag_suppress=L6314W,L6329W" 
;* option to the linker. Simply comment out or remove the relevant code in the 
;* linker file.
;*
;*******************************************************************************
;* \copyright
;* (c) (2016-2021), Cypress Semiconductor Corporation (an Infineon company) or
;* an affiliate of Cypress Semiconductor Corporation. All rights reserved.
;********************************************************************************
;* This software, including source code, documentation and related materials
;* ("Software") is owned by Cypress Semiconductor Corporation or one of its
;* affiliates ("Cypress") and is protected by and subject to worldwide patent
;* protection (United States and foreign), United States copyright laws and
;* international treaty provisions. Therefore, you may use this Software only
;* as provided in the license agreement accompanying the software package from
;* which you obtained this Software ("EULA").
;*
;* If no EULA applies, Cypress hereby grants you a personal, non-exclusive,
;* non-transferable license to copy, modify, and compile the Software source
;* code solely for use in connection with Cypress's integrated circuit products.
;* Any reproduction, modification, translation, compilation, or representation
;* of this Software except as specified above is prohibited without the express
;* written permission of Cypress.
;*
;* Disclaimer: THIS SOFTWARE IS PROVIDED AS-IS, WITH NO WARRANTY OF ANY KIND,
;* EXPRESS OR IMPLIED, INCLUDING, BUT NOT LIMITED TO, NONINFRINGEMENT, IMPLIED
;* WARRANTIES OF MERCHANTABILITY AND FITNESS FOR A PARTICULAR PURPOSE. Cypress
;* reserves the right to make changes to the Software without notice. Cypress
;* does not assume any liability arising out of the application or use of the
;* Software or any product or circuit described in the Software. Cypress does
;* not authorize its products for use in any products where a malfunction or
;* failure of the Cypress product may reasonably be expected to result in
;* significant property damage, injury or death ("High Risk Product"). By
;* including Cypress's product in a High Risk Product, the manufacturer of such
;* system or application assumes all risk of such use and in doing so agrees to
;* indemnify Cypress against all liability.
;******************************************************************************/

;* DFU SDK specific: includes defines common across all the applications
#include "dfu_common.h"

;* DFU SDK specific: defines the memory regions
;* Make sure the correct app no. is entered here

; RAM
#define RAM_START               CY_APP1_RAM_ADDR
#define RAM_SIZE                CY_APP1_RAM_LENGTH

; Flash
#define FLASH_START             CY_APP1_FLASH_ADDR
#define FLASH_SIZE              CY_APP1_FLASH_LENGTH

#define STACK_SIZE              0x00001000

; Emulated EEPROM flash area
#define EM_EEPROM_START         CY_APP0_EM_EEPROM_ADDR
#define EM_EEPROM_SIZE          CY_APP0_EM_EEPROM_LENGTH

; The following defines describe device specific memory regions and must not be changed.
; Supervisory flash: User data
#define SFLASH_USER_DATA_START  0x16000800
#define SFLASH_USER_DATA_SIZE   0x00000800

; Supervisory flash: Normal Access Restrictions (NAR)
#define SFLASH_NAR_START        0x16001A00
#define SFLASH_NAR_SIZE         0x00000200

; Supervisory flash: Public Key
#define SFLASH_PUBLIC_KEY_START 0x16005A00
#define SFLASH_PUBLIC_KEY_SIZE  0x00000C00

; Supervisory flash: Table of Content # 2
#define SFLASH_TOC_2_START      0x16007C00
#define SFLASH_TOC_2_SIZE       0x00000400

; Supervisory flash: Table of Content # 2 Copy
#define SFLASH_RTOC_2_START     0x16007E00
#define SFLASH_RTOC_2_SIZE      0x00000200

; External memory
#define XIP_START               CY_APP0_SMIF_ADDR
#define XIP_SIZE                CY_APP0_SMIF_LENGTH

; eFuse
#define EFUSE_START             0x90700000
#define EFUSE_SIZE              0x100000


; Cortex-M4 application image
LR_IROM1 FLASH_START FLASH_SIZE
{
    ER_FLASH_VECTORS +0
    {
        * (RESET, +FIRST)
    }

    ER_FLASH_CODE +0 FIXED
    {
        * (InRoot$$Sections)
        * (+RO)
    }
    
    ER_RAM_COMMON CY_APP_RAM_COMMON_ADDR UNINIT
    {
        * (.cy_boot_noinit.appId)
    }

    ER_RAM_VECTORS RAM_START UNINIT
    {
        * (RESET_RAM, +FIRST)
    }

    RW_RAM_DATA +0
    {
        * (.cy_ramfunc)
        * (+RW, +ZI)
    }

    ; Place variables in the section that should not be initialized during the
    ; device startup.
    RW_IRAM1 +0 UNINIT
    {
        * (.noinit)
    }

    ; Application heap area (HEAP)
    ARM_LIB_HEAP  +0 EMPTY ((RAM_START+RAM_SIZE)-AlignExpr(ImageLimit(RW_IRAM1), 8)-STACK_SIZE)
    { 
    }
    
    ; Stack region growing down
    ARM_LIB_STACK (RAM_START+RAM_SIZE) EMPTY -STACK_SIZE
    {
    }

    ; Used for the digital signature of the Cypress Standard Application and the
    ; DFU SDK application. The size of the section depends on the required
    ; data size.
    .cy_app_signature (FLASH_START + FLASH_SIZE - CY_BOOT_SIGNATURE_SIZE) FIXED
    {
        * (.cy_app_signature)
    }
}

; App0 uses it to initialize DFU SDK metadata, in dfu_user.c file
LR_CY_BOOT_METADATA CY_BOOT_META_FLASH_ADDR CY_BOOT_META_FLASH_LENGTH
{
    .cy_boot_metadata + 0
    {
        * (.cy_boot_metadata)
    }
}

; Emulated EEPROM flash area
LR_EM_EEPROM EM_EEPROM_START EM_EEPROM_SIZE
{
    .cy_em_eeprom +0
    {
        * (.cy_em_eeprom)
    }
}

; Supervisory flash: User data
LR_SFLASH_USER_DATA SFLASH_USER_DATA_START SFLASH_USER_DATA_SIZE
{
    .cy_sflash_user_data +0
    {
        * (.cy_sflash_user_data)
    }
}

; Supervisory flash: Normal Access Restrictions (NAR)
LR_SFLASH_NAR SFLASH_NAR_START SFLASH_NAR_SIZE
{
    .cy_sflash_nar +0
    {
        * (.cy_sflash_nar)
    }
}

; Supervisory flash: Public Key
LR_SFLASH_PUBLIC_KEY SFLASH_PUBLIC_KEY_START SFLASH_PUBLIC_KEY_SIZE
{
    .cy_sflash_public_key +0
    {
        * (.cy_sflash_public_key)
    }
}

; Supervisory flash: Table of Content # 2
LR_SFLASH_TOC_2 SFLASH_TOC_2_START SFLASH_TOC_2_SIZE
{
    .cy_toc_part2 +0
    {
        * (.cy_toc_part2)
    }
}

; Supervisory flash: Table of Content # 2 Copy
LR_SFLASH_RTOC_2 SFLASH_RTOC_2_START SFLASH_RTOC_2_SIZE
{
    .cy_rtoc_part2 +0
    {
        * (.cy_rtoc_part2)
    }
}


; Places the code in the Execute in Place (XIP) section. See the smif driver documentation for details.
LR_EROM XIP_START XIP_SIZE
{
    .cy_xip +0
    {
        * (.cy_xip)
    }
}

; eFuse
LR_EFUSE EFUSE_START EFUSE_SIZE
{
    .cy_efuse +0
    {
        * (.cy_efuse)
    }
}

; The section is used for additional metadata (silicon revision, Silicon/JTAG ID, etc.) storage.
CYMETA 0x90500000
{
    .cymeta +0 { * (.cymeta) }
}

/* [] END OF FILE */
